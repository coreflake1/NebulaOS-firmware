## br2-external/package/python-apprise/Config.in
```kconfig
config BR2_PACKAGE_PYTHON_APPRISE
	bool "python-apprise"
	select BR2_PACKAGE_PYTHON_REQUESTS
	select BR2_PACKAGE_PYTHON_REQUESTS_OAUTHLIB
	select BR2_PACKAGE_PYTHON_MARKDOWN
	select BR2_PACKAGE_PYTHON_YAML
	select BR2_PACKAGE_PYTHON_CLICK
	help
	  Moonraker notification backend (scripts/moonraker-requirements.txt: apprise>=1.9.3,<=1.9.8).

	  https://pypi.org/project/apprise/
```

## br2-external/package/python-importlib-metadata/Config.in
```kconfig
config BR2_PACKAGE_PYTHON_IMPORTLIB_METADATA
	bool "python-importlib-metadata"
	select BR2_PACKAGE_PYTHON_ZIPP
	help
	  Moonraker imports the BACKPORT explicitly: moonraker/utils/source_info.py does `from importlib_metadata import Distribution, PathDistribution, PackageMetadata`. Python 3.12's stdlib importlib.metadata does NOT satisfy that import, so this is required even on 3.12.

	  https://pypi.org/project/importlib_metadata/
```

## br2-external/package/python-inotify-simple/Config.in
```kconfig
config BR2_PACKAGE_PYTHON_INOTIFY_SIMPLE
	bool "python-inotify-simple"
	help
	  Moonraker filesystem watching (moonraker-requirements.txt: inotify-simple==2.0.1). Distinct from Buildroot's python-pyinotify, which is a different library with a different API.

	  https://pypi.org/project/inotify_simple/
```

## br2-external/package/python-ldap3/Config.in
```kconfig
config BR2_PACKAGE_PYTHON_LDAP3
	bool "python-ldap3"
	select BR2_PACKAGE_PYTHON_PYASN1
	help
	  Moonraker LDAP authentication source (moonraker-requirements.txt: ldap3==2.9.1).

	  https://pypi.org/project/ldap3/
```

## br2-external/package/python-libnacl/Config.in
```kconfig
config BR2_PACKAGE_PYTHON_LIBNACL
	bool "python-libnacl"
	select BR2_PACKAGE_LIBSODIUM
	help
	  Moonraker API-key/JWT crypto (moonraker-requirements.txt: libnacl==2.1.0). A ctypes binding to libsodium, NOT the same as Buildroot's python-pynacl (a CFFI binding with a different module name); Moonraker imports libnacl specifically.

	  https://pypi.org/project/libnacl/
```

## br2-external/package/python-preprocess-cancellation/Config.in
```kconfig
config BR2_PACKAGE_PYTHON_PREPROCESS_CANCELLATION
	bool "python-preprocess-cancellation"
	help
	  Moonraker gcode object-cancellation preprocessor (moonraker-requirements.txt: preprocess-cancellation==0.2.1).

	  https://pypi.org/project/preprocess_cancellation/
```

## br2-external/package/python-smart-open/Config.in
```kconfig
config BR2_PACKAGE_PYTHON_SMART_OPEN
	bool "python-smart-open"
	select BR2_PACKAGE_PYTHON_WRAPT # runtime
	help
	  Runtime dependency of python-streaming-form-data 1.19.1, which declares smart-open>=7.0.5 and imports it at module load (streaming_form_data/targets.py). Without it Moonraker dies at import.

	  https://pypi.org/project/smart-open/
```

## br2-external/package/python-streaming-form-data/Config.in
```kconfig
config BR2_PACKAGE_PYTHON_STREAMING_FORM_DATA
	bool "python-streaming-form-data"
	help
	  Moonraker streaming multipart upload parser (moonraker-requirements.txt: streaming-form-data>=1.11.0,<=1.19.1). Ships a NATIVE CPython extension, _parser.

	  https://pypi.org/project/streaming_form_data/
```

## br2-external/package/python-wheel-target/Config.in
```kconfig
config BR2_PACKAGE_PYTHON_WHEEL_TARGET
	bool "python-wheel (target)"
	help
	  The `wheel` distribution, installed into TARGET site-packages.

	  Buildroot 2025.02.18 packages wheel as host-only
	  (package/python-wheel uses host-python-package and ships an empty
	  Config.in), so there is no upstream way to get it onto the target.
	  The current qualified NebulaOS image does have it in target
	  site-packages - it arrived as a side effect of the `pip3 download`
	  step this migration removed - so it is re-provided here rather than
	  dropped.

	  This exists for PARITY, not because a shipped component imports it.
	  Neither klippy-requirements.txt nor moonraker-requirements.txt lists
	  wheel. It is a candidate for the deferred cleanup mission, where it
	  can be removed against evidence rather than assumption.

	  https://pypi.org/project/wheel/
```

## br2-external/package/python-zipp/Config.in
```kconfig
config BR2_PACKAGE_PYTHON_ZIPP
	bool "python-zipp"
	help
	  Runtime dependency of python-importlib-metadata. Present in the current qualified image (zipp-3.20.2.dist-info); 06-verify.sh asserts its presence.

	  https://pypi.org/project/zipp/
```
